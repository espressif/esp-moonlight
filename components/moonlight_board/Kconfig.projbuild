## components/moonlight_board/Kconfig.projbuild
```kconfig
menu "SELECT BOARD"
    config ESP32_MOONLIGHT_BOARD
        bool "Select ESP32_MOONLIGHT_BOARD"
        default "y"    if IDF_TARGET_ESP32
        help
            Select ESP32_MOONLIGHT_BOARD.

    config ESP32_S3_MOONLIGHT_BOARD
        bool "Select ESP32_S3_MOONLIGHT_BOARD"
        default "y"    if IDF_TARGET_ESP32S3
        help
            Select ESP32_S3_MOONLIGHT_BOARD.
endmenu
```

## examples/5_app_control/main/Kconfig.projbuild
```kconfig
menu "Example Configuration"

    config EXAMPLE_PORT
        int "UDP Port"
        range 0 65535
        default 3333
        help
            Local port the example server will listen on.

endmenu
```

## examples/6_ota/main/Kconfig.projbuild
```kconfig
menu "Example Configuration"

    config EXAMPLE_PORT
        int "UDP Port"
        range 0 65535
        default 3333
        help
            Local port the example server will listen on.

    config EXAMPLE_FIRMWARE_UPGRADE_URL
        string "firmware upgrade url endpoint"
        default "https://192.168.0.118:8070/moonlight.bin"
        help
            URL of server which hosts the firmware
            image.

    config EXAMPLE_SKIP_COMMON_NAME_CHECK
        bool "Skip server certificate CN fieldcheck"
        default n
        help
            This allows you to skip the validation of OTA server certificate CN field.
endmenu
```

## examples/7_recognition/sdkconfig.defaults
```kconfig
#
# Serial flasher config
#
CONFIG_ESPTOOLPY_FLASHMODE_QIO=y
CONFIG_ESPTOOLPY_FLASHFREQ_80M=y
CONFIG_ESPTOOLPY_FLASHSIZE_4MB=y

#
# FreeRTOS
#

#
# Kernel
#
CONFIG_FREERTOS_HZ=1000

#
# Partition Table
#
CONFIG_PARTITION_TABLE_CUSTOM=y
```

## examples/7_recognition/sdkconfig.defaults.esp32
```kconfig
#
# ESP32-specific
#
CONFIG_ESP32_DEFAULT_CPU_FREQ_240=y

#
# Partition Table
#
CONFIG_PARTITION_TABLE_CUSTOM_FILENAME="partitions_esp32.csv"

#
# ESP Speech Recognition
#
CONFIG_USE_WAKENET=y
CONFIG_SR_WN_WN5_HILEXIN=y
CONFIG_USE_MULTINET=y
CONFIG_SR_MN_CN_MULTINET2_SINGLE_RECOGNITION=y
CONFIG_SR_MN_EN_NONE=y
```

## examples/7_recognition/sdkconfig.defaults.esp32s3
```kconfig
#
# ESP System Settings
#
CONFIG_ESP_DEFAULT_CPU_FREQ_MHZ_240=y
CONFIG_ESP_DEFAULT_CPU_FREQ_MHZ=240

#
# Serial flasher config
#
CONFIG_ESPTOOLPY_FLASHSIZE_8MB=y
CONFIG_ESPTOOLPY_FLASHSIZE="8MB"

#
# Partition Table
#
CONFIG_PARTITION_TABLE_CUSTOM_FILENAME="partitions_esp32s3.csv"

#
# ESP PSRAM
#
CONFIG_SPIRAM=y

#
# SPI RAM config
#
CONFIG_SPIRAM_MODE_OCT=y
CONFIG_SPIRAM_TYPE_AUTO=y
CONFIG_SPIRAM_ALLOW_STACK_EXTERNAL_MEMORY=y

CONFIG_MODEL_IN_SPIFFS=y
CONFIG_USE_WAKENET=y
CONFIG_SR_WN_WN9_HILEXIN=y
CONFIG_USE_MULTINET=y
CONFIG_SR_MN_CN_MULTINET6_AC_QUANT=y
CONFIG_SR_MN_EN_NONE=y
```
